// SPDX-License-Identifier: BSD-3-Clause
/*
 * Copyright (c) 2024 Qualcomm Innovation Center, Inc. All rights reserved.
 */

/dts-v1/;

#include "sdxkova.dtsi"
#include "sdxkova-idp-cpe-v3.dtsi"
#include "sdxkova-reserved-memory-2G.dtsi"
/ {
	model = "Qualcomm Technologies, Inc. SDXKOVA IDP CPE V3";
	compatible = "qcom,sdxkova-idp",
			"qcom,sdxkova", "qcom,idp";
	qcom,msm-id = <677 0x10000>, <678 0x10000>, <679 0x10000>;
	qcom,board-id = <0x1030022 0x401>;
};
