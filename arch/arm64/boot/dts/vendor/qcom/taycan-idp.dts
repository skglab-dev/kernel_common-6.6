// SPDX-License-Identifier: BSD-3-Clause
/*
 * Copyright (c) Qualcomm Technologies, Inc. and/or its subsidiaries.
 */

/dts-v1/;

#include "taycan.dtsi"
#include "ravelin-idp.dtsi"

/ {
	model = "Qualcomm Technologies, Inc. Taycan IDP";
	compatible = "qcom,taycan-idp", "qcom,taycan", "qcom,idp";
	qcom,board-id = <34 0>;
};
