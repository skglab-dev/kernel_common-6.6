// SPDX-License-Identifier: BSD-3-Clause
/*
 * Copyright (c) Qualcomm Technologies, Inc. and/or its subsidiaries.
 */

/dts-v1/;

#include "sdxkova.dtsi"
#include "sdxkova-idp-cpe-v7.dtsi"
#include "sdxkova-reserved-memory-2G.dtsi"

/ {
	model = "Qualcomm Technologies, Inc. SDXKOVA IDP CPE V7";
	compatible = "qcom,sdxkova-idp",
			"qcom,sdxkova", "qcom,idp";
	qcom,msm-id = <677 0x10000>, <678 0x10000>, <679 0x10000>, <725 0x10000>, <726 0x10000>;
	qcom,board-id = <0x1070022 0x401>;
};
