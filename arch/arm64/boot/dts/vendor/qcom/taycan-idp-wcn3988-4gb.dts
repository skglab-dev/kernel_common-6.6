// SPDX-License-Identifier: BSD-3-Clause
/*
 * Copyright (c) Qualcomm Technologies, Inc. and/or its subsidiaries.
 */

/dts-v1/;

#include "taycan-4gb.dtsi"
#include "ravelin-idp-wcn3988-4gb.dtsi"

/ {
	model = "Qualcomm Technologies, Inc. Taycan IDP 4GB DDR + WCN3988";
	compatible = "qcom,taycan-idp", "qcom,taycan", "qcom,idp";
	qcom,board-id = <34 0x601>;
};
