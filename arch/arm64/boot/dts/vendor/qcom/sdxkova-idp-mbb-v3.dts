// SPDX-License-Identifier: BSD-3-Clause
/*
 * Copyright (c) Qualcomm Technologies, Inc. and/or its subsidiaries.
 */

/dts-v1/;

#include "sdxkova.dtsi"
#include "sdxkova-idp-mbb-v3.dtsi"
#include "sdxkova-reserved-memory.dtsi"
/ {
	model = "Qualcomm Technologies, Inc. SDXKOVA IDP MBB V3";
	compatible = "qcom,sdxkova-idp",
			"qcom,sdxkova", "qcom,idp";
	qcom,msm-id = <677 0x10000>, <678 0x10000>, <679 0x10000>;
	qcom,board-id = <0x30022 0x300>, <0x30022 0x400>;
};

