// SPDX-License-Identifier: BSD-3-Clause
/*
 * Copyright (c) Qualcomm Technologies, Inc. and/or its subsidiaries.
 */

/dts-v1/;

#include "sdxkova.dtsi"
#include "sdxkova-idp-lga-v2.dtsi"
#include "sdxkova-reserved-memory-sub6-2G.dtsi"

/ {
	model = "Qualcomm Technologies, Inc. SDXKOVA IDP LGA V2";
	compatible = "qcom,sdxkova-idp",
			"qcom,sdxkova", "qcom,idp";
	qcom,msm-id = <677 0x10000>, <678 0x10000>, <679 0x10000>;
	qcom,board-id = <0x3020022 0x403>;
};
