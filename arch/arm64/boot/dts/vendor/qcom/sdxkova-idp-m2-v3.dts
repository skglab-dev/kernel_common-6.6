// SPDX-License-Identifier: BSD-3-Clause
/*
 * Copyright (c) 2024-2025 Qualcomm Innovation Center, Inc. All rights reserved.
 */

/dts-v1/;

#include "sdxkova.dtsi"
#include "sdxkova-idp-m2-v3.dtsi"
#include "sdxkova-reserved-memory-sub6.dtsi"

/ {
	model = "Qualcomm Technologies, Inc. SDXKOVA IDP M2 V3";
	compatible = "qcom,sdxkova-idp",
			"qcom,sdxkova", "qcom,idp";
	qcom,msm-id = <677 0x10000>, <678 0x10000>, <679 0x10000>;
	qcom,board-id = <0x2030022 0x302>;
};
